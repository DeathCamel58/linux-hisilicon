## arch/arm/mach-hisi/Kconfig
```kconfig
# SPDX-License-Identifier: GPL-2.0-only
config ARCH_HISI
	bool "Hisilicon SoC Support"
	depends on ARCH_MULTI_V7 || (ARCH_MULTI_V5 && CPU_LITTLE_ENDIAN)
	select ARM_AMBA
	select ARM_GIC if ARCH_MULTI_V7
	select ARM_VIC if ARCH_MULTI_V5
	select ARM_TIMER_SP804
	select POWER_RESET
	select POWER_RESET_HISI
	select POWER_SUPPLY

if ARCH_HISI

menu "Hisilicon platform type"

config ARCH_HI3516A
	bool "Hisilicon Hi3516A Cortex-A7(Single) family"
	depends on ARCH_MULTI_V7
	select HAVE_ARM_ARCH_TIMER
	select ARM_GIC
	select ARCH_HAS_RESET_CONTROLLER
	select RESET_CONTROLLER
	help
		Support for Hisilicon Hi3516A Soc family.

config ARCH_HI3518EV20X
	bool "Hisilicon Hi3518ev20x ARM926T(Single) family"
	depends on ARCH_MULTI_V5
	select PINCTRL
	select PINCTRL_SINGLE
	help
		Support for Hisilicon Hi3518ev20x Soc family.

config ARCH_HI3536DV100
	bool "Hisilicon Hi3536DV100 Cortex-A7(Single) family"
	depends on ARCH_MULTI_V7
	select HAVE_ARM_ARCH_TIMER
	select PINCTRL
	help
		Support for Hisilicon Hi3536DV100 Soc family.

config ARCH_HI3521A
	bool "Hisilicon Hi3521A A7(Single) family"
	depends on ARCH_MULTI_V7
	select HAVE_ARM_ARCH_TIMER
	select ARM_GIC
	select PINCTRL
	select PINCTRL_SINGLE
	help
		Support for Hisilicon Hi3521a Soc family.

config ARCH_HI3531A
   bool "Hisilicon Hi3531A A9 family" if ARCH_MULTI_V7
   select HAVE_ARM_ARCH_TIMER
   select ARM_GIC
   select CACHE_L2X0
   select PINCTRL
   select PINCTRL_SINGLE
   select HAVE_ARM_SCU if SMP
   select NEED_MACH_IO_H if PCI
   help
       Support for Hisilicon Hi3531a Soc family.

config HI_ZRELADDR
       hex 'zreladdr'
       default "0x80008000" if ARCH_HI3516A
       default "0x80008000" if ARCH_HI3518EV20X
       default "0x80008000" if ARCH_HI3536DV100
       default "0x80008000" if ARCH_HI3521A
       default "0x40008000" if ARCH_HI3531A

config HI_PARAMS_PHYS
       hex 'params_phys'
       default "0x00000100"

config HI_INITRD_PHYS
       hex 'initrd_phys'
       default "0x00800000"

config ARCH_HI3620
	bool "Hisilicon Hi3620 family"
	depends on ARCH_MULTI_V7
	select CACHE_L2X0
	select HAVE_ARM_SCU if SMP
	select HAVE_ARM_TWD if SMP
	select PINCTRL
	select PINCTRL_SINGLE
	help
	  Support for Hisilicon Hi3620 SoC family

config ARCH_HIP01
	bool "Hisilicon HIP01 family"
	depends on ARCH_MULTI_V7
	select HAVE_ARM_SCU if SMP
	select HAVE_ARM_TWD if SMP
	select ARM_GLOBAL_TIMER
	help
	  Support for Hisilicon HIP01 SoC family

config ARCH_HIP04
	bool "Hisilicon HiP04 Cortex A15 family"
	depends on ARCH_MULTI_V7
	select ARM_ERRATA_798181 if SMP
	select HAVE_ARM_ARCH_TIMER
	select MCPM if SMP
	select MCPM_QUAD_CLUSTER if SMP
	select GENERIC_IRQ_EFFECTIVE_AFF_MASK if SMP
	help
	  Support for Hisilicon HiP04 SoC family

config ARCH_HIX5HD2
	bool "Hisilicon X5HD2 family"
	depends on ARCH_MULTI_V7
	select CACHE_L2X0
	select HAVE_ARM_SCU if SMP
	select HAVE_ARM_TWD if SMP
	select PINCTRL
	select PINCTRL_SINGLE
	help
	  Support for Hisilicon HIX5HD2 SoC family

config ARCH_SD5203
	bool "Hisilicon SD5203 family"
	depends on ARCH_MULTI_V5
	select DW_APB_ICTL
	help
	  Support for Hisilicon SD5203 SoC family

endmenu

endif
```
